// Copyright 2021 Manna Harbour
// https://github.com/manna-harbour/miryoku

#include "../miryoku/custom_config.h"
#include "../miryoku/mapping/50/kyria.h"
#include "../miryoku/custom_babel.h"
#include "../miryoku/miryoku.dtsi"
